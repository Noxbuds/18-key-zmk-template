## boards/shields/nox_18/Kconfig.defconfig
```kconfig
if SHIELD_NOX_18_LEFT

    config ZMK_KEYBOARD_NAME
        default "Nox 18"

    config ZMK_SPLIT_ROLE_CENTRAL
        default y

endif

if SHIELD_NOX_18_LEFT || SHIELD_NOX_18_RIGHT
    config ZMK_SPLIT
        default y

endif
```

## boards/shields/nox_18/Kconfig.shield
```kconfig
config SHIELD_NOX_18_LEFT
    def_bool $(shields_list_contains,nox_18_left)

config SHIELD_NOX_18_RIGHT
    def_bool $(shields_list_contains,nox_18_right)
```
